## firmware/main/Kconfig.projbuild
```kconfig
menu "SimulRepile Application Configuration"

config APP_MAX_TERRARIUMS
    int "Maximum number of terrariums"
    range 1 8
    default 4
    help
        Defines how many terrariums can be simulated simultaneously.
        Keep this value aligned with the UI layout (4 slots maximum).

config APP_AUTOSAVE_INTERVAL_S
    int "Autosave interval (seconds)"
    range 30 3600
    default 120
    help
        Interval between automatic persistence operations. Values below
        30 seconds may impact SD throughput without benefit.

config APP_ENABLE_COMPRESSION
    bool "Enable save data compression"
    default n
    help
        Activate the optional compression backend defined in
        components/compression_if. Disable to simplify debugging of
        JSON save payloads.

config APP_ENABLE_WIFI_OTA
    bool "Enable Wi-Fi OTA updates"
    default n
    help
        Allow firmware upgrades through Wi-Fi in addition to SD card
        based updates. Requires Wi-Fi credentials management.

config APP_ENABLE_TTS_STUB
    bool "Enable TTS stub"
    default n
    help
        Provide a stub Text-To-Speech hook for accessibility testing.
        Implementations can be swapped at runtime through the settings
        screen.

config APP_LANG_DEFAULT
    string "Default language (ISO 639-1 code)"
    default "fr"
    help
        ISO 639-1 language code loaded during the first boot. Users can
        switch language at runtime through the settings screen.

config APP_THEME_HIGH_CONTRAST
    bool "Enable high-contrast theme by default"
    default y
    help
        Enables the accessible color palette on first boot. Users may
        revert to the standard theme from the settings screen.

config APP_ASSET_CACHE_CAPACITY
    int "Asset cache capacity (entries)"
    range 1 128
    default 8
    help
        Maximum number of assets simultaneously kept in PSRAM by the
        /sdcard-backed cache. Entries above this limit are evicted based
        on a least-recently-used policy with periodic idle sweeps.

config APP_ASSET_CACHE_HASH_BUCKETS
    int "Asset cache hash buckets"
    range 8 512
    default 64
    help
        Number of buckets in the asset cache hash table. Increase this
        value when storing many assets simultaneously to limit
        collisions. Lower values reduce RAM consumption at the cost of
        lookup speed.

config APP_ASSET_CACHE_IDLE_GRACE_TICKS
    int "Asset cache idle grace (ticks)"
    range 0 600
    default 3
    help
        Number of scheduler ticks an unused asset remains cached before
        the periodic sweep evicts it. Set to zero to evict immediately
        when the reference count drops to zero.

config APP_ASSET_CACHE_MAX_PATH
    int "Asset cache maximum path length"
    range 64 512
    default 256
    help
        Maximum length of normalized asset paths handled by the cache.
        Must be large enough to cover the longest path stored on the SD
        card, including the /sdcard prefix.

menu "Core Link Bridge"

config APP_CORE_LINK_UART_PORT
    int "UART port used for the core link"
    range 0 2
    default 1
    help
        Select the UART controller used to communicate with the
        ESP32-S3-DevKitC core board. UART1 is routed to GPIO43/GPIO44 on
        the Waveshare carrier and is free by default.

config APP_CORE_LINK_UART_TX_PIN
    int "Core link UART TX GPIO"
    default 43
    help
        GPIO driving the TX line towards the DevKitC bridge. Adapt this
        value if you re-route the differential pair via the CH422G or a
        mezzanine connector.

config APP_CORE_LINK_UART_RX_PIN
    int "Core link UART RX GPIO"
    default 44
    help
        GPIO receiving data from the DevKitC bridge. Make sure the pin is
        not reused by the LCD or SD peripheral when rewiring the board.

config APP_CORE_LINK_UART_BAUD
    int "Core link UART baud rate"
    range 115200 4000000
    default 2000000
    help
        Serial baud rate for the master<->display RPC channel. 2 Mbps
        provides a good balance between throughput and signal integrity
        over short ribbon cables.

config APP_CORE_LINK_HANDSHAKE_TIMEOUT_MS
    int "Core link handshake timeout (ms)"
    range 100 60000
    default 5000
    help
        Maximum duration to wait for the DevKitC to acknowledge the
        display endpoint during boot. If the timeout expires the display
        falls back to local stubs.

config APP_CORE_LINK_STATE_TIMEOUT_MS
    int "Core link state watchdog timeout (ms)"
    range 500 60000
    default 4000
    help
        Maximum delay tolerated between two state updates (`STATE_FULL`
        or `STATE_DELTA`) coming from the DevKitC. When the timeout
        expires the display endpoint
        probes the link with a ping and eventually falls back to the
        internal simulation if the DevKitC stays silent.

config APP_CORE_LINK_FULL_REFRESH_TIMEOUT_MS
    int "Core link STATE_FULL refresh timeout (ms)"
    range 1000 60000
    default 12000
    help
        Maximum delay tolerated between two complete `STATE_FULL`
        snapshots. When the DevKitC only streams incremental deltas for
        too long the display endpoint pings the peer and forces a
        resynchronization before falling back to the internal
        simulation.

config APP_CORE_LINK_PING_TIMEOUT_MS
    int "Core link ping response timeout (ms)"
    range 100 5000
    default 800
    help
        Duration to wait for a PONG response after emitting a watchdog
        PING when the DevKitC stops publishing state frames. If the
        timeout expires the bridge is considered lost and the UI falls
        back to the local simulator while displaying an alert banner.

endmenu

menu "Board Support Package Options"

choice BSP_SD_BUS_WIDTH
    prompt "SD bus width"
    default BSP_SD_BUS_WIDTH_1BIT
    help
        Select the data bus width for the SD/MMC interface. 1-bit is the
        safe default for wiring simplicity; 4-bit provides higher
        throughput when all data lines are available.

config BSP_SD_BUS_WIDTH_1BIT
    bool "1-bit"

config BSP_SD_BUS_WIDTH_4BIT
    bool "4-bit"
endchoice

config BSP_USB_CAN_SELECTABLE
    bool "Allow runtime USB/CAN selection"
    default y
    help
        Exposes the CH422G EXIO5 line allowing the user to switch
        between native USB (CDC) and CAN functionality from the
        settings screen.

config BSP_BATTERY_MONITOR
    bool "Enable on-board battery monitor"
    default y
    help
        Enables the lithium battery voltage monitor. When enabled the
        BSP samples the configured ADC channel periodically and reports
        the filtered cell voltage to the user interface.

if BSP_BATTERY_MONITOR

choice BSP_BATTERY_ADC_UNIT
    prompt "ADC unit for battery sensing"
    default BSP_BATTERY_ADC_UNIT_1
    help
        Selects the ADC peripheral used to monitor the battery divider.

config BSP_BATTERY_ADC_UNIT_1
    bool "ADC unit 1"

config BSP_BATTERY_ADC_UNIT_2
    bool "ADC unit 2"
endchoice

config BSP_BATTERY_ADC_CHANNEL
    int "ADC channel index"
    range 0 9
    default 4
    help
        Numeric ADC channel connected to the battery sense divider.
        Refer to the carrier schematic when adjusting this value.

choice BSP_BATTERY_ATTEN
    prompt "ADC attenuation"
    default BSP_BATTERY_ATTEN_DB_11
    help
        Select the attenuation applied to the ADC channel. Higher
        attenuation allows measuring higher voltages at the cost of
        precision for low voltages.

config BSP_BATTERY_ATTEN_DB_0
    bool "0 dB"

config BSP_BATTERY_ATTEN_DB_2_5
    bool "2.5 dB"

config BSP_BATTERY_ATTEN_DB_6
    bool "6 dB"

config BSP_BATTERY_ATTEN_DB_11
    bool "11 dB"
endchoice

config BSP_BATTERY_DIVIDER_RHIGH_KOHM
    int "High-side resistor value (kΩ)"
    range 1 1000
    default 200
    help
        Value in kilo-ohms of the resistor connected between VBAT and
        the ADC sense node. Used to convert the sense voltage back to
        the cell voltage.

config BSP_BATTERY_DIVIDER_RLOW_KOHM
    int "Low-side resistor value (kΩ)"
    range 1 1000
    default 100
    help
        Value in kilo-ohms of the resistor connected between the sense
        node and ground.

config BSP_BATTERY_OFFSET_MV
    int "Calibration offset (mV)"
    range -500 500
    default 0
    help
        Optional offset applied after converting the divider voltage to
        millivolts. Tune this value with a calibrated multimeter to
        cancel systematic errors.

config BSP_BATTERY_SAMPLES
    int "Samples per reading"
    range 1 64
    default 16
    help
        Number of ADC samples taken for each battery measurement. More
        samples reduce noise at the cost of additional latency.

config BSP_BATTERY_FILTER_ALPHA_NUM
    int "Filter coefficient numerator"
    range 1 64
    default 1
    help
        Numerator of the exponential moving average applied to successive
        battery readings. Must be less or equal to the denominator.

config BSP_BATTERY_FILTER_ALPHA_DEN
    int "Filter coefficient denominator"
    range 1 128
    default 4
    help
        Denominator of the exponential moving average applied to
        successive battery readings.

endif # BSP_BATTERY_MONITOR

endmenu

endmenu
```

## firmware/sdkconfig.defaults
```kconfig
# Core target configuration
CONFIG_IDF_TARGET="esp32s3"
CONFIG_SPIRAM_BOOT_INIT=y
CONFIG_SPIRAM=y
CONFIG_SPIRAM_USE_MEMMAP=y
CONFIG_SPIRAM_TYPE_AUTO=y
CONFIG_SPIRAM_SPEED_80M=y
CONFIG_SPIRAM_MODE_OCT=y
CONFIG_SPIRAM_BANKSWITCH_ENABLE=y
CONFIG_SPIRAM_MALLOC_ALWAYSINTERNAL=16384

# Logging and debugging
CONFIG_LOG_DEFAULT_LEVEL_INFO=y
CONFIG_ESP_CONSOLE_USB_SERIAL_JTAG=y

# LVGL & graphics defaults
CONFIG_LV_CONF_SKIP=y
CONFIG_LVGL_TICK_CUSTOM=y
CONFIG_LV_COLOR_DEPTH_16=y
CONFIG_LV_COLOR_16_SWAP=y
CONFIG_LV_MEM_CUSTOM=y

# Storage / SD
CONFIG_SDMMC_HOST_DEFAULT_SPEED=y
CONFIG_SDMMC_USE_1LINE_MODE=y

# Application defaults (Kconfig symbols defined in Kconfig file)
CONFIG_APP_MAX_TERRARIUMS=4
CONFIG_APP_AUTOSAVE_INTERVAL_S=120
CONFIG_APP_ENABLE_COMPRESSION=n
CONFIG_APP_ENABLE_WIFI_OTA=n
CONFIG_APP_ENABLE_TTS_STUB=n
CONFIG_APP_LANG_DEFAULT="fr"
CONFIG_APP_THEME_HIGH_CONTRAST=y
CONFIG_APP_ASSET_CACHE_CAPACITY=8
CONFIG_APP_ASSET_CACHE_HASH_BUCKETS=64
CONFIG_APP_ASSET_CACHE_IDLE_GRACE_TICKS=3
CONFIG_APP_ASSET_CACHE_MAX_PATH=256
CONFIG_BSP_SD_BUS_WIDTH_1BIT=y
CONFIG_BSP_USB_CAN_SELECTABLE=y
CONFIG_BSP_BATTERY_MONITOR=y
CONFIG_BSP_BATTERY_ADC_UNIT_1=y
CONFIG_BSP_BATTERY_ADC_CHANNEL=4
CONFIG_BSP_BATTERY_ATTEN_DB_11=y
CONFIG_BSP_BATTERY_DIVIDER_RHIGH_KOHM=200
CONFIG_BSP_BATTERY_DIVIDER_RLOW_KOHM=100
CONFIG_BSP_BATTERY_OFFSET_MV=0
CONFIG_BSP_BATTERY_SAMPLES=16
CONFIG_BSP_BATTERY_FILTER_ALPHA_NUM=1
CONFIG_BSP_BATTERY_FILTER_ALPHA_DEN=4
CONFIG_APP_CORE_LINK_UART_PORT=1
CONFIG_APP_CORE_LINK_UART_TX_PIN=43
CONFIG_APP_CORE_LINK_UART_RX_PIN=44
CONFIG_APP_CORE_LINK_UART_BAUD=2000000
CONFIG_APP_CORE_LINK_HANDSHAKE_TIMEOUT_MS=5000
CONFIG_APP_CORE_LINK_STATE_TIMEOUT_MS=4000
CONFIG_APP_CORE_LINK_FULL_REFRESH_TIMEOUT_MS=12000
CONFIG_APP_CORE_LINK_PING_TIMEOUT_MS=800
```

## main/Kconfig.projbuild
```kconfig
config REPTILE_DEBUG
    bool "Activer le mode debug (désactive la veille)"
    default n

config SIMULREPILE_SD_FAKE
    bool "Activer le mode simulation microSD"
    default n
    help
        Lorsque cette option est activée, l'initialisation SD est court-circuitée
        et un volume simulé est créé sur le système de fichiers hôte. À utiliser
        pour les tests automatisés sans carte microSD physique.

config SIMULREPILE_SD_MOUNT_STACK_WORDS
    int "Profondeur de pile (mots) pour la tâche de montage microSD"
    range 4096 32768
    default 8192
    help
        La routine de montage SDSPI alloue une structure FATFS volumineuse et
        effectue plusieurs appels d'E/S bloquants. Pour éviter les exceptions
        WindowOverflow lors des montages lents, augmenter la profondeur de pile
        dédiée à la tâche sd_mount. Les unités sont des mots FreeRTOS (4 octets).
```

## sdkconfig.defaults
```kconfig
CONFIG_IDF_TARGET="esp32s3"
CONFIG_ESP_DEFAULT_CPU_FREQ_MHZ_240=y
# CONFIG_ESPTOOLPY_FLASH_MODE_AUTO_DETECT is not set
CONFIG_ESPTOOLPY_FLASHMODE_DIO=y
CONFIG_FLASHMODE_DIO=y
# CONFIG_FLASHMODE_QIO is not set
CONFIG_ESPTOOLPY_FLASHFREQ_80M=y
CONFIG_ESPTOOLPY_FLASHSIZE_16MB=y
CONFIG_SPIRAM=y
CONFIG_SPIRAM_MODE_OCT=y
CONFIG_IDF_EXPERIMENTAL_FEATURES=y
CONFIG_SPIRAM_SPEED_80M=y
CONFIG_SPIRAM_FETCH_INSTRUCTIONS=y
CONFIG_SPIRAM_RODATA=y
CONFIG_SPIRAM_TRY_ALLOCATE_WIFI_LWIP=y

CONFIG_I2C_MASTER_SDA_GPIO=8
CONFIG_I2C_MASTER_SCL_GPIO=9
CONFIG_I2C_MASTER_FREQUENCY_HZ=400000
CONFIG_I2C_MASTER_ENABLE_INTERNAL_PULLUPS=y

CONFIG_CH422G_I2C_ADDR=0x24
CONFIG_GT911_I2C_ADDR=0x5D

CONFIG_SD_SPI_MOSI_IO=11
CONFIG_SD_SPI_MISO_IO=13
CONFIG_SD_SPI_SCLK_IO=12
CONFIG_SD_USE_FALLBACK_GPIO_CS=y
CONFIG_SD_SPI_CS_IO=34
CONFIG_SD_FALLBACK_CS_GPIO=34
CONFIG_SPI_MASTER_ISR_IN_IRAM=y
CONFIG_SD_AUTOMOUNT=y
CONFIG_SD_MOUNT_POINT="/sdcard"

CONFIG_ESP_INT_WDT_TIMEOUT_MS=800
CONFIG_INT_WDT_TIMEOUT_MS=800

CONFIG_FREERTOS_HZ=1000
CONFIG_ESP32S3_DATA_CACHE_LINE_64B=y
CONFIG_COMPILER_OPTIMIZATION_PERF=y

CONFIG_FATFS_LFN_HEAP=y

CONFIG_LV_USE_PERF_MONITOR=y
CONFIG_LV_MEM_SIZE_KILOBYTES=160
CONFIG_LV_MEM_POOL_EXPAND_SIZE_KILOBYTES=32
CONFIG_LV_FONT_MONTSERRAT_16=y
CONFIG_LV_FONT_MONTSERRAT_20=y
CONFIG_LV_FONT_MONTSERRAT_24=y
CONFIG_LV_USE_TABVIEW=y
CONFIG_LV_USE_TABLE=y
```

## tools/i2c_scanner/sdkconfig.defaults
```kconfig
CONFIG_LOG_DEFAULT_LEVEL_DEBUG=y
CONFIG_ESP_TASK_WDT=n
CONFIG_I2C_MASTER_SDA_GPIO=8
CONFIG_I2C_MASTER_SCL_GPIO=9
CONFIG_I2C_MASTER_FREQUENCY_HZ=100000
```
