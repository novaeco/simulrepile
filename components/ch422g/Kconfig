## components/ch422g/Kconfig
```kconfig
menu "CH422G expander"

config CH422G_I2C_ADDRESS
    hex "CH422G 7-bit I2C address"
    range 0x08 0x77
    default 0x20
    help
        Adresse I2C (7 bits) de l'extenseur de ports CH422G. Les cartes
        Waveshare utilisent 0x20 par défaut (0x40 au format 8 bits). Adaptez
        cette valeur si les broches A0/A1/A2 sont recâblées.

config CH422G_EXIO_SD_CS
    int "CH422G EXIO line driving the SD CS"
    range 1 8
    default 4
    help
        Numéro d'EXIO (1..8) du CH422G utilisé pour piloter la ligne chip-select
        du lecteur microSD. Les cartes Waveshare 1024x600 câblent l'entrée EXIO4
        vers le convertisseur de niveau du slot SD.

endmenu
```

## components/i2c/Kconfig
```kconfig
menu "I2C bus"

config I2C_MASTER_SDA_GPIO
    int "I2C SDA GPIO"
    range 0 48
    default 8
    help
        GPIO de données (SDA) utilisé par le bus I2C maître partagé entre
        l'extenseur CH422G, le contrôleur tactile GT911 et tout capteur
        additionnel. La valeur par défaut correspond au routage Waveshare
        d'origine (GPIO8).

config I2C_MASTER_SCL_GPIO
    int "I2C SCL GPIO"
    range 0 48
    default 9
    help
        GPIO d'horloge (SCL) du bus I2C maître. Par défaut le port est câblé
        sur GPIO9 conformément au schéma Waveshare ESP32-S3.

config I2C_MASTER_FREQUENCY_HZ
    int "I2C clock frequency (Hz)"
    range 10000 1000000
    default 200000
    help
        Fréquence de l'horloge I2C maître en hertz. La valeur par défaut de
        200 kHz offre un compromis robustesse/débit pour les nappes longues.

config I2C_MASTER_ENABLE_INTERNAL_PULLUPS
    bool "Enable internal pull-ups on SDA/SCL"
    default y
    help
        Active les résistances de tirage internes de l'ESP32-S3 en complément
        des pull-ups externes. Désactivez cette option si le bus est déjà
        fortement polarisé pour éviter un dépassement de courant.

endmenu
```

## components/sd/Kconfig
```kconfig
menu "Storage / SD card"

config SD_SPI_MOSI_IO
    int "GPIO MOSI pour le bus SPI microSD"
    range 0 48
    default 11
    help
        Broche MOSI (COPI) du bus SDSPI connecté au lecteur microSD de la carte
        Waveshare ESP32-S3 Touch LCD 7B. La valeur par défaut reflète le
        routage d'usine (GPIO11).

config SD_SPI_MISO_IO
    int "GPIO MISO pour le bus SPI microSD"
    range 0 48
    default 13
    help
        Broche MISO (CIPO) du bus SDSPI. Par défaut elle correspond au GPIO13
        présent sur la nappe TF.

config SD_SPI_SCLK_IO
    int "GPIO SCLK pour le bus SPI microSD"
    range 0 48
    default 12
    help
        Broche d'horloge SPI dédiée au lecteur microSD. La configuration
        standard Waveshare relie SCLK au GPIO12 de l'ESP32-S3.

config SD_AUTOMOUNT
    bool "Monter automatiquement la carte microSD au démarrage"
    default y
    help
        Lorsque cette option est activée, l'application tente de monter la
        carte microSD au démarrage afin de rendre les journaux et profils
        LVGL immédiatement disponibles. Désactiver l'option pour reporter le
        montage à une étape ultérieure de l'initialisation.

config SD_MOUNT_POINT
    string "Point de montage de la carte microSD"
    default "/sdcard"
    help
        Point de montage FAT exposé dans le VFS une fois la carte initialisée.
        Adapter si l'application doit publier le volume sous un répertoire
        différent.

config SD_USE_FALLBACK_GPIO_CS
    bool "Forcer CS microSD sur un GPIO natif"
    default y
    help
        Active la commande directe de la ligne chip-select microSD par un GPIO
        de l'ESP32-S3. Ce contournement est obligatoire avec l'extenseur
        CH422G, le bus I²C ne pouvant être sollicité depuis les callbacks ISR
        du driver SDSPI.

config SD_SPI_CS_IO
    int "GPIO utilisé pour la ligne CS microSD"
    range 0 48
    default 34
    help
        Numéro de GPIO employé pour piloter la ligne CS du lecteur microSD.
        Sur la Waveshare ESP32-S3 Touch LCD 7B, la broche 34 est accessible sur
        le connecteur d'extension et ne rentre pas en conflit avec le bus RGB.

config SD_FALLBACK_CS_GPIO
    int
    default SD_SPI_CS_IO
    help
        Alias rétrocompatible. Utiliser SD_SPI_CS_IO pour configurer la broche
        CS du bus SDSPI.

endmenu
```

## components/storage/Kconfig
```kconfig
menu "Storage / SD card"

config STORAGE_SD_USE_GPIO_CS
    bool "Use direct GPIO for SD card CS instead of CH422G"
    default n
    help
        Enable this option only when the SD card chip-select line is wired
        directly to an ESP32-S3 GPIO. The driver will never touch the CH422G
        expander when this mode is selected.

config STORAGE_SD_GPIO_FALLBACK
    bool "Allow automatic GPIO CS fallback when CH422G probe fails"
    depends on !STORAGE_SD_USE_GPIO_CS
    default y
    help
        When enabled, the storage driver will automatically configure the
        fallback GPIO defined below if the CH422G expander cannot be reached at
        boot. This is useful when the expander is absent, temporarily
        miswired or when the firmware needs to continue operating while the
        bus is repaired.

config STORAGE_SD_GPIO_FALLBACK_AUTO_MOUNT
    bool "Automatically mount the SD card when the fallback CS is engaged"
    depends on STORAGE_SD_GPIO_FALLBACK
    default n
    help
        Enable this option only when the CH422G expander is permanently
        unavailable *and* the CS line has been hard-wired from EXIO to the
        fallback GPIO. Leaving this disabled keeps the firmware from blocking
        inside esp_vfs_fat_sdspi_mount() when no working CS path exists,
        preventing watchdog resets. Once the wiring is in place, enable the
        option to let the firmware attempt the direct-GPIO mount automatically.

config STORAGE_SD_GPIO_CS_NUM
    int "GPIO number for the SD card CS fallback"
    depends on STORAGE_SD_USE_GPIO_CS || STORAGE_SD_GPIO_FALLBACK
    range 0 48
    default 34
    help
        Physical GPIO used to drive the SD card chip-select when bypassing the
        CH422G expander. Waveshare spare headers expose GPIO34 which is safe to
        use without conflicting with the RGB data bus.

endmenu
```

## core_firmware/main/Kconfig.projbuild
```kconfig
menu "SimulRepile Core Configuration"

config CORE_APP_LINK_UART_PORT
    int "UART port"
    range 0 2
    default 1
    help
        Port UART matériel utilisé pour la liaison vers la Waveshare.

config CORE_APP_LINK_UART_TX_PIN
    int "UART TX pin"
    default 17
    help
        Broche TX du DevKitC reliée au RX de la Waveshare.

config CORE_APP_LINK_UART_RX_PIN
    int "UART RX pin"
    default 18
    help
        Broche RX du DevKitC reliée au TX de la Waveshare.

config CORE_APP_LINK_UART_BAUD
    int "UART baud rate"
    default 2000000
    help
        Débit de la liaison UART (bits/s). 2 Mbps recommandé pour les frames LVGL.

config CORE_APP_HANDSHAKE_TIMEOUT_MS
    int "Handshake timeout (ms)"
    default 5000
    help
        Temps maximum d'attente pour l'acquittement `HELLO_ACK` et `DISPLAY_READY`.

config CORE_APP_HANDSHAKE_RETRY_MS
    int "Handshake retry interval (ms)"
    default 500
    help
        Intervalle entre deux émissions `HELLO` lorsque l'afficheur n'a pas encore répondu.

config CORE_APP_LINK_STATE_TIMEOUT_MS
    int "Display inactivity timeout (ms)"
    default 4000
    help
        Durée maximale sans réception de trame avant émission d'un `PING` vers l'afficheur.

config CORE_APP_LINK_PING_TIMEOUT_MS
    int "Ping timeout (ms)"
    default 800
    help
        Délai d'attente d'un `PONG` (ou d'une trame) avant de considérer l'afficheur comme déconnecté.

config CORE_APP_STATE_PUBLISH_INTERVAL_MS
    int "State publish interval (ms)"
    default 500
    help
        Intervalle entre deux envois périodiques de `STATE_FULL`.

config CORE_APP_STATE_BASE_EPOCH
    int "Base epoch timestamp"
    default 1704067200
    help
        Epoch Unix de référence utilisée en l'absence de RTC ou synchronisation réseau.

config CORE_APP_TOUCH_RELIEF_DELTA
    int "Touch relief delta"
    default 5
    help
        Pourcentage de réduction du stress quand un contact tactile DOWN est reçu.

config CORE_STATE_PROFILE_BASE_PATH
    string "Chemin profils (SD)"
    default "/sdcard/profiles"
    help
        Répertoire primaire sur la carte SD contenant les fichiers JSON
        `*.json` décrivant les profils terrarium.

config CORE_STATE_PROFILE_SPIFFS_PATH
    string "Chemin profils (SPIFFS)"
    default "/spiffs/profiles"
    help
        Répertoire de secours monté en SPIFFS. Laisser vide pour désactiver
        le fallback embarqué.

endmenu
```

## core_firmware/sdkconfig.defaults
```kconfig
CONFIG_IDF_TARGET="esp32s3"
CONFIG_SPIRAM_BOOT_INIT=y
CONFIG_SPIRAM=y
CONFIG_SPIRAM_USE_CAPS_ALLOC=y
CONFIG_SPIRAM_TYPE_AUTO=y
CONFIG_SPIRAM_SPEED_80M=y
CONFIG_SPIRAM_MODE_OCT=y
CONFIG_SPIRAM_BANKSWITCH_ENABLE=y
CONFIG_SPIRAM_MALLOC_ALWAYSINTERNAL=16384
CONFIG_LOG_DEFAULT_LEVEL_INFO=y
CONFIG_ESP_CONSOLE_USB_SERIAL_JTAG=y
CONFIG_CORE_APP_LINK_UART_PORT=1
CONFIG_CORE_APP_LINK_UART_TX_PIN=17
CONFIG_CORE_APP_LINK_UART_RX_PIN=18
CONFIG_CORE_APP_LINK_UART_BAUD=2000000
CONFIG_CORE_APP_HANDSHAKE_TIMEOUT_MS=5000
CONFIG_CORE_APP_HANDSHAKE_RETRY_MS=500
CONFIG_CORE_APP_LINK_STATE_TIMEOUT_MS=4000
CONFIG_CORE_APP_LINK_PING_TIMEOUT_MS=800
CONFIG_CORE_APP_STATE_PUBLISH_INTERVAL_MS=500
CONFIG_CORE_APP_STATE_BASE_EPOCH=1704067200
CONFIG_CORE_APP_TOUCH_RELIEF_DELTA=5
CONFIG_CORE_STATE_PROFILE_BASE_PATH="/sdcard/profiles"
CONFIG_CORE_STATE_PROFILE_SPIFFS_PATH="/spiffs/profiles"
```
